## 009-m5stack-lcd/main/Kconfig.projbuild
```kconfig
menu "ILI9341 Configuration"

config LCD_OVERCLOCK
	bool
	prompt "Run LCD at higher clock speed than allowed"
	default "n"
	help
		The ILI9341 and ST7789 specify that the maximum clock speed for the SPI interface is 10MHz. However,
		in practice the driver chips work fine with a higher clock rate, and using that gives a better framerate.
		Select this to try using the out-of-spec clock rate.

endmenu
```

## 012-mqtt-wifi/main/Kconfig.projbuild
```kconfig
menu "MQTT Wifi Example"

config WIFI_SSID
    string "Wifi SSID"
    default ""
    help
        SSID (network name) to connect to.

config WIFI_PASSWORD
    string "Wifi Password"
    default ""
    help
        WiFi password

config MQTT_USERNAME
    string "MQTT username"
    default ""
    help
        This can also sometimes be the access key.

config MQTT_PASSWORD
    string "MQTT Password"
    default ""
    help
        MQTT password.


endmenu
```

## 015-m5stick-gfx/sdkconfig.defaults
```kconfig
# This file contains working settings for M5StickC (80x160 ST7735S).
#
# https://www.banggood.com/custlink/GmDKBVm6t9
# http://s.click.aliexpress.com/e/3DmuIePq
# https://m5stack.com/collections/m5-core/products/stick-c
#
# To use it copy it to your project root before running menuconfig.
#
# $ cp components/esp_mipi/sdkconfig/m5stickc-portrait.defaults sdkconfig.defaults
# $ make menuconfig

CONFIG_MIPI_DCS_ADDRESS_MODE_MIRROR_Y_SELECTED=y
CONFIG_MIPI_DCS_ADDRESS_MODE_MIRROR_X_SELECTED=y
CONFIG_MIPI_DCS_ADDRESS_MODE_MIRROR_Y=0x80
CONFIG_MIPI_DCS_ADDRESS_MODE_MIRROR_X=0x40
CONFIG_MIPI_DCS_ADDRESS_MODE_SWAP_XY=0x00
CONFIG_MIPI_DCS_ADDRESS_MODE_FLIP_X=0x00
CONFIG_MIPI_DCS_ADDRESS_MODE_FLIP_Y=0x00
CONFIG_MIPI_DCS_PIXEL_FORMAT_16BIT_SELECTED=y
CONFIG_MIPI_DISPLAY_PIXEL_FORMAT=0x55
CONFIG_MIPI_DISPLAY_WIDTH=80
CONFIG_MIPI_DISPLAY_HEIGHT=160
CONFIG_MIPI_DISPLAY_OFFSET_X=26
CONFIG_MIPI_DISPLAY_OFFSET_Y=1
CONFIG_MIPI_DISPLAY_INVERT=y
CONFIG_MIPI_DCS_ADDRESS_MODE_BGR_SELECTED=y
CONFIG_MIPI_DCS_ADDRESS_MODE_BGR=0x08
CONFIG_SPI_CLOCK_SPEED_HZ=20000000
CONFIG_MIPI_DISPLAY_PIN_MISO=-1
CONFIG_MIPI_DISPLAY_PIN_MOSI=15
CONFIG_MIPI_DISPLAY_PIN_CLK=13
CONFIG_MIPI_DISPLAY_PIN_CS=5
CONFIG_MIPI_DISPLAY_PIN_DC=23
CONFIG_MIPI_DISPLAY_PIN_RST=18
CONFIG_MIPI_DISPLAY_PIN_BL=-1

# This file contains default settings for M5StickC
#
# https://www.banggood.com/custlink/GmDKBVm6t9
# http://s.click.aliexpress.com/e/3DmuIePq
# https://m5stack.com/collections/m5-core/products/stick-c
#
# To use it copy it to your project root before running menuconfig.
#
# $ cp components/axp192/sdkconfig/m5stickc.defaults sdkconfig.defaults
# $ make menuconfig

CONFIG_AXP192_DCDC13_LDO23_CONTROL_BIT6_SELECTED=y
CONFIG_AXP192_DCDC13_LDO23_CONTROL_BIT4_SELECTED=y
CONFIG_AXP192_DCDC13_LDO23_CONTROL_BIT3_SELECTED=y
CONFIG_AXP192_DCDC13_LDO23_CONTROL_BIT2_SELECTED=y
CONFIG_AXP192_GPIO0_CONTROL_LDOIO0_SELECTED=y
CONFIG_AXP192_DCDC13_LDO23_CONTROL_BIT1_SELECTED=y
CONFIG_AXP192_DCDC13_LDO23_CONTROL_BIT0_SELECTED=y
CONFIG_AXP192_EXTEN_DCDC2_CONTROL_BIT2=0x04
CONFIG_AXP192_EXTEN_DCDC2_CONTROL_BIT0=0x01
CONFIG_AXP192_DCDC13_LDO23_CONTROL_BIT6=0x40
CONFIG_AXP192_DCDC13_LDO23_CONTROL_BIT4=0x10
CONFIG_AXP192_DCDC13_LDO23_CONTROL_BIT3=0x08
CONFIG_AXP192_DCDC13_LDO23_CONTROL_BIT2=0x04
CONFIG_AXP192_GPIO0_CONTROL_BIT20=0x02
CONFIG_AXP192_DCDC13_LDO23_CONTROL_BIT1=0x02
CONFIG_AXP192_DCDC13_LDO23_CONTROL_BIT0=0x01
CONFIG_AXP192_GPIO0_LDOIO0_VOLTAGE_BIT74_3V3=y
CONFIG_AXP192_GPIO0_LDOIO0_VOLTAGE_BIT74=0xf0
CONFIG_AXP192_LDO23_VOLTAGE_BIT74_2V8=y
CONFIG_AXP192_LDO23_VOLTAGE_BIT74=0xa0
CONFIG_AXP192_LDO23_VOLTAGE_BIT30_3V0=y
CONFIG_AXP192_LDO23_VOLTAGE_BIT30=0x0c
CONFIG_AXP192_ADC_ENABLE_1_BIT7_SELECTED=y
CONFIG_AXP192_ADC_ENABLE_1_BIT6_SELECTED=y
CONFIG_AXP192_ADC_ENABLE_1_BIT5_SELECTED=y
CONFIG_AXP192_ADC_ENABLE_1_BIT4_SELECTED=y
CONFIG_AXP192_ADC_ENABLE_1_BIT3_SELECTED=y
CONFIG_AXP192_ADC_ENABLE_1_BIT2_SELECTED=y
CONFIG_AXP192_ADC_ENABLE_1_BIT1_SELECTED=y
CONFIG_AXP192_ADC_ENABLE_1_BIT0_SELECTED=y
CONFIG_AXP192_ADC_ENABLE_1_BIT7=0x80
CONFIG_AXP192_ADC_ENABLE_1_BIT6=0x40
CONFIG_AXP192_ADC_ENABLE_1_BIT5=0x20
CONFIG_AXP192_ADC_ENABLE_1_BIT4=0x10
CONFIG_AXP192_ADC_ENABLE_1_BIT3=0x08
CONFIG_AXP192_ADC_ENABLE_1_BIT2=0x04
CONFIG_AXP192_ADC_ENABLE_1_BIT1=0x02
CONFIG_AXP192_ADC_ENABLE_1_BIT0=0x01
CONFIG_AXP192_CHARGE_CONTROL_1_BIT7_SELECTED=y
CONFIG_AXP192_CHARGE_CONTROL_1_BIT7=0x80
CONFIG_AXP192_CHARGE_CONTROL_1_BIT65_42_SELECTED=y
CONFIG_AXP192_CHARGE_CONTROL_1_BIT65=0x40
CONFIG_AXP192_CHARGE_CONTROL_1_BIT30_100_SELECTED=y
CONFIG_AXP192_CHARGE_CONTROL_1_BIT30=0x00
CONFIG_AXP192_CHARGE_CONTROL_1_BIT4_15_SELECTED=y
CONFIG_AXP192_CHARGE_CONTROL_1_BIT4=0x10
```
